## examples/std/sdkconfig.defaults
```kconfig
# Examples often require a larger than the default stack size for the main thread and for the sysloop event task.
# Necessary when the `embassy-time-driver` feature is enabled
CONFIG_ESP_TIMER_TASK_STACK_SIZE=4096
CONFIG_ESP_MAIN_TASK_STACK_SIZE=20000
CONFIG_ESP_SYSTEM_EVENT_TASK_STACK_SIZE=8192
CONFIG_PTHREAD_TASK_STACK_SIZE_DEFAULT=8192
```
